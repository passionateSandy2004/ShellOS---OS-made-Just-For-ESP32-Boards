## sdkconfig.defaults
```kconfig
# Common ShellOS defaults (all targets). Target-specific files:
#   sdkconfig.defaults.esp32    — ESP32-CAM + PSRAM + camera SCCB
#   sdkconfig.defaults.esp32c6 — Seeed XIAO ESP32C6 (no camera stack)

CONFIG_ESPTOOLPY_FLASHSIZE_4MB=y
CONFIG_ESPTOOLPY_FLASHMODE_DIO=y
CONFIG_ESPTOOLPY_FLASHFREQ_80M=y

# ── UART console ─────────────────────────────────────────────────────────────
CONFIG_ESP_CONSOLE_UART_DEFAULT=y
CONFIG_ESP_CONSOLE_UART_NUM=0
CONFIG_ESP_CONSOLE_UART_BAUDRATE=115200

# ── WiFi ─────────────────────────────────────────────────────────────────────
# Generous RX + dynamic TX buffers so package uploads never stall
CONFIG_ESP_WIFI_ENABLED=y
CONFIG_ESP_WIFI_STATIC_RX_BUFFER_NUM=8
CONFIG_ESP_WIFI_DYNAMIC_RX_BUFFER_NUM=16
CONFIG_ESP_WIFI_DYNAMIC_TX_BUFFER=y
CONFIG_ESP_WIFI_TX_BUFFER_TYPE=1
CONFIG_ESP_WIFI_DYNAMIC_TX_BUFFER_NUM=16

# ── FreeRTOS ──────────────────────────────────────────────────────────────────
# 1 kHz tick → 1 ms resolution for timeouts, vTaskDelay, select()
CONFIG_FREERTOS_HZ=1000

# ── Main task ─────────────────────────────────────────────────────────────────
# app_main does NVS init + kernel_boot (FS mount, WiFi autoconnect) before
# spawning shell_task — give it enough headroom.
CONFIG_ESP_MAIN_TASK_STACK_SIZE=16384

# ── Partition — factory app + LittleFS (see partitions.csv) ──────────────────
CONFIG_PARTITION_TABLE_CUSTOM=y
CONFIG_PARTITION_TABLE_CUSTOM_FILENAME="partitions.csv"
CONFIG_PARTITION_TABLE_FILENAME="partitions.csv"
```

## sdkconfig.defaults.esp32
```kconfig
# ESP32-CAM (AI Thinker) — give the full board to ShellOS
# Appended on top of sdkconfig.defaults by idf.py for target esp32.

# ── CPU ───────────────────────────────────────────────────────────────────────
CONFIG_ESP32_DEFAULT_CPU_FREQ_240=y

# ── PSRAM (4 MB external, on all AI Thinker modules) ─────────────────────────
#
#  Strategy: route malloc() to PSRAM so the 4 MB external RAM is fully
#  available to ShellOS (Lua heap, HTTP upload buffers, file content, etc.).
#  Task stacks and other small hot allocations stay in fast internal SRAM
#  so context switches are never delayed by the PSRAM latency penalty.
#
CONFIG_ESP32_SPIRAM_SUPPORT=y
CONFIG_SPIRAM_USE_MALLOC=y
CONFIG_SPIRAM_BOOT_INIT=y

# Allocations <= 16 KB go to internal SRAM.
# This covers every task stack we create (shell 16K, netsh 16K, httpd 8K …)
# and all small kernel objects (mutexes, queues, TCBs, sockets).
CONFIG_SPIRAM_MALLOC_ALWAYSINTERNAL=16384

# Reserve 32 KB of internal heap unconditionally so critical paths never
# fail due to fragmentation even while PSRAM is heavily loaded.
CONFIG_SPIRAM_MALLOC_RESERVE_INTERNAL=32768

# ── WiFi IRAM optimisations ───────────────────────────────────────────────────
# Run the WiFi driver's hot paths directly from IRAM — cuts interrupt
# latency and improves TCP throughput at 240 MHz.
CONFIG_ESP32_WIFI_IRAM_OPT=y
CONFIG_ESP32_WIFI_RX_IRAM_OPT=y

# ── Camera SCCB ───────────────────────────────────────────────────────────────
CONFIG_SCCB_HARDWARE_I2C_PORT0=y
```

## sdkconfig.defaults.esp32c6
```kconfig
# Seeed XIAO ESP32-C6 (4 MB flash, no external PSRAM on typical modules)

CONFIG_ESP_DEFAULT_CPU_FREQ_MHZ_160=y

# USB-C on XIAO is USB Serial/JTAG — same COM port as ShellOS UART I/O
CONFIG_ESP_CONSOLE_USB_SERIAL_JTAG=y
# CONFIG_ESP_CONSOLE_UART_DEFAULT is not set
CONFIG_ESP_CONSOLE_SECONDARY_NONE=y
```
